// Written by Anuj Jain
#include <LedControl.h>
#include <SoftwareSerial.h>
LedControl lc=LedControl(12,11,5,4);
SoftwareSerial mySerial(9,10);
char garbage_value[150],msg[150];
int index=0;

byte Font8x5[104*8] =
        {0x00, 0x00, 0x00, 0x00, 0x00, 0x00, 0x00, 0x00, 
        0x02, 0x02, 0x02, 0x02, 0x02, 0x00, 0x02, 0x00,
        0x05, 0x05, 0x05, 0x00, 0x00, 0x00, 0x00, 0x00,
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        0x1C, 0x22, 0x45, 0x49, 0x41, 0x22, 0x1C, 0x00};
byte lentbl_S[104] =
{
        2, 2, 3, 5, 5, 5, 5, 2, 
        3, 3, 5, 5, 2, 5, 1, 5, 
        5, 4, 5, 5, 5, 5, 5, 5, 
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        7, 7, 7, 7, 7, 7, 7, 7
};

int curcharix = 0;
int curcharbit = 0;
int curcharixsave = 0;
int curcharbitsave = 0;
int curcharixsave2 = 0;
int curcharbitsave2 = 0;
char curchar;


void setup()
{
  Serial.begin(9600);
  mySerial.begin(9600);   // Setting the baud rate of GSM Module  
  mySerial.println("AT+CMGF=1\r");
  mySerial.println("AT+CNMI=2,2,0,0,0");
  delay(100);
  while(mySerial.available())
  {
  mySerial.read();
  }
  lc.shutdown(0,false);// turn off power saving, enables display
  lc.setIntensity(0,15);// sets brightness (0~15 possible values)
  lc.clearDisplay(0);// clear screen
  lc.shutdown(1,false);// turn off power saving, enables display
  lc.setIntensity(1,15);// sets brightness (0~15 possible values)
  lc.clearDisplay(1);// clear screen
  lc.shutdown(2,false);// turn off power saving, enables display
  lc.setIntensity(2,15);// sets brightness (0~15 possible values)
  lc.clearDisplay(2);// clear screen
  lc.shutdown(3,false);// turn off power saving, enables display
  lc.setIntensity(3,15);// sets brightness (0~15 possible values)
  lc.clearDisplay(3);// clear screen
  lc.shutdown(4,false);// turn off power saving, enables display
  lc.setIntensity(4,15);// sets brightness (0~15 possible values)
  lc.clearDisplay(4);// clear screen
  lc.shutdown(5,false);// turn off power saving, enables display
  lc.setIntensity(5,15);// sets brightness (0~15 possible values)
  lc.clearDisplay(5);// clear screen
}
void loop()
{
  get_msg();
  if(index!=0)
  {
  for(int x=0;x<index;x++)
  {
    if(garbage_value[x]=='*')
    {
      for(int y=x+1;y<index;y++)
      {
        msg[y-(x+1)]=garbage_value[y];
       
      }
      break;
    }
  }
  for(int x=0;x<index;x++)
  {
    Serial.print(msg[x]);
  }


  index=0;
  }
    printled();
}
void get_msg()
{
  while(mySerial.available()>0)
  {
    garbage_value[index]=(char)mySerial.read();
    index++;
    delay(100);
  }
}

void printled()
{  
  int i,j,k;
  int msgsize = strlen(msg);
  curcharixsave2 = curcharix;
    curcharbitsave2 = curcharbit;

    for (i=5;i>=0;i--) // Loop through our 8 displays
    {
      for (j=0;j<8;j++) // Set up rows on current  display
      {      
        byte outputbyte = 0;
      
        curchar = msg[curcharix];
      
        curcharixsave = curcharix;
        curcharbitsave = curcharbit;
      
        for (k=7;k>=0;k--) // Copy over data for 8 columns to current row and send it to current display
        {
          // This byte is the bitmap of the current character for the current row
          byte currentcharbits = Font8x5[((curchar-32)*8)+j];
      
          if (currentcharbits & (1<<curcharbit))
            outputbyte |= (1<<k);
      
          // advance the current character bit of current character
      
          curcharbit ++;
      
          if (curcharbit > lentbl_S[curchar-32]) // we are past the end of this character, so advance.
          {
            curcharbit = 0;
            curcharix += 1;          
            if (curcharix+1 > msgsize) curcharix=0;
            curchar = msg[curcharix];
          }
        }
      
        lc.setRow(i, j, outputbyte);

        if (j != 7) // if this is not the last row, roll back advancement, if it is, leave the counters advanced.
        {
          curcharix = curcharixsave;
          curcharbit = curcharbitsave;
        }
      }
    }
  
    curcharix = curcharixsave2;
    curcharbit = curcharbitsave2;
 
    curchar = msg[curcharix];
 
    // advance the current character bit of current character
      
    curcharbit ++;
      
    if (curcharbit > lentbl_S[curchar-32]) // we are past the end of this character, so advance.
    {
      curcharbit = 0;
      curcharix += 1;
      if (curcharix+1 > msgsize) curcharix=0;
      curchar = msg[curcharix];
    }
    
    delay(10);
}
